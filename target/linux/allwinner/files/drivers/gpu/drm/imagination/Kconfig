## target/linux/allwinner/files/drivers/gpu/drm/imagination/Kconfig
```kconfig
# SPDX-License-Identifier: GPL-2.0-only OR MIT
# Copyright (c) 2023 Imagination Technologies Ltd.

config DRM_POWERVR
	tristate "Imagination Technologies PowerVR (Series 6 and later) & IMG Graphics"
	depends on (ARM64 || RISCV && 64BIT)
	depends on DRM
	depends on MMU
	depends on PM
	select DRM_EXEC
	select DRM_GEM_SHMEM_HELPER
	select DRM_SCHED
	select FW_LOADER
	help
	  Choose this option if you have a system that has an Imagination
	  Technologies PowerVR (Series 6 or later) or IMG GPU.

	  This is a backport of the upstream drm/imagination driver to Linux 6.6.
	  Allwinner A733 BXM-4-64 (BVNC 36.56.104.183) needs firmware
	  powervr/rogue_36.56.104.183_v1.fw and exp_hw_support=1.

	  If "M" is selected, the module will be called powervr.
```
